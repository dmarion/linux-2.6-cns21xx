## arch/arm/mach-cns21xx/Kconfig
```kconfig
if ARCH_CNS21XX

menu "Cavium ECONA CNS21XX Options"

config MACH_NSK330
	bool "Support for NS-K330 NAS"
	select ARCH_CNS21XX_SPI
	select ARCH_CNS21XX_USB
	select ARCH_CNS21XX_NIC
	help
	  Support for the NS-K330 and other CNS2132 (ex STAR STR8132) based
	  NAS devices (WLXKJ652, Ritmo LN-86BT, etc.)

config ARCH_CNS21XX_SPI
	def_bool n

config ARCH_CNS21XX_USB
	def_bool n

config ARCH_CNS21XX_NIC
	def_bool n

config ARCH_CNS21XX_EARLY_CONSOLE
	bool "Enable UART0 port in early boot stage."
	help
	  This option is typically needed for debugging kernel 
	  in early boot stage, before UART is configured in standard way.

endmenu

endif
```

## drivers/net/cns21xx/Kconfig
```kconfig
config CNS21XX_GEC
	tristate  "CNS21XX Gigabit Ethernet Controller support"
	depends on ARCH_CNS21XX
	help
	  If you wish to compile a kernel for Cavium Networks CNS21XX
	  with ethernet support, then you should always answer Y to this.
```
